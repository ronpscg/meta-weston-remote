## conf/layer.conf
```bitbake
# We have a conf and classes directory, add to BBPATH
BBPATH .= ":${LAYERDIR}"

# We have recipes-* directories, add to BBFILES
BBFILES += "${LAYERDIR}/recipes-*/*/*.bb \
            ${LAYERDIR}/recipes-*/*/*.bbappend"

BBFILE_COLLECTIONS += "meta-weston-remote"
BBFILE_PATTERN_meta-weston-remote = "^${LAYERDIR}/"
BBFILE_PRIORITY_meta-weston-remote = "6"

LAYERDEPENDS_meta-weston-remote = "core"

# Testing note: only tested with master en route to whinlatter. I assume it is compatible with the other branches as well
LAYERSERIES_COMPAT_meta-weston-remote = "whinlatter walnascar styhead scarthgap"
```
